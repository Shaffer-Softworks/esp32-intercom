## sdkconfig.defaults
```kconfig
# ESP32 Intercom Default Configuration for Waveshare ESP32-P4-86

# Target chip
CONFIG_IDF_TARGET="esp32p4"

# CPU Configuration (matching ESPHome)
CONFIG_ESP_DEFAULT_CPU_FREQ_MHZ_400=y
CONFIG_ESP_DEFAULT_CPU_FREQ_MHZ=400

# Flash Configuration (matching ESPHome: 32MB)
CONFIG_PARTITION_TABLE_CUSTOM=y
CONFIG_PARTITION_TABLE_CUSTOM_FILENAME="partitions.csv"

# Enable WiFi
CONFIG_ESP_WIFI_STATIC_RX_BUFFER_NUM=10
CONFIG_ESP_WIFI_DYNAMIC_RX_BUFFER_NUM=32

# Enable WebSocket support
CONFIG_ESP_HTTP_CLIENT_ENABLE_WEBSOCKET=y

# I2C Configuration
CONFIG_I2C_ENABLE_DEBUG_LOG=n

# I2S configuration
CONFIG_I2S_ENABLE_DEBUG_LOG=n

# FreeRTOS
CONFIG_FREERTOS_HZ=1000

# Log level
CONFIG_LOG_DEFAULT_LEVEL_INFO=y
# Uncomment for debug:
# CONFIG_LOG_DEFAULT_LEVEL_DEBUG=y

# GPIO
CONFIG_GPIO_ESP32_SUPPORT_SWITCH_SLP_PULL=y

# PSRAM (if available)
CONFIG_SPIRAM=y
CONFIG_SPIRAM_SPEED_200M=y
```
